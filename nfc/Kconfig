## nfc/Kconfig
```kconfig
#
# near field communication configuration
#

config NXP_NFC_I2C
    tristate "NFC on I2C Interface"
    depends on I2C
    ---help---
      This selects Near field controller on I2C Interface.

      If you want NFC support, you should say Y here and
      also to your specific host controller driver.

config NXP_NFC_I3C
    tristate "NFC on I3C Interface"
    depends on I3C
    ---help---
      This selects Near field controller on I3C Interface.

      If you want NFC support, you should say Y here and
      also to your specific host controller driver.

config NXP_NFC_SN110
    bool "Nxp NFC sn110 Controller"
    ---help---
      You'll have to say Y if your computer contains an sn110 i2C device that
      you want to use under Linux.

      You can say N here if you don't have any sn110 I2C connected to your computer.
```
